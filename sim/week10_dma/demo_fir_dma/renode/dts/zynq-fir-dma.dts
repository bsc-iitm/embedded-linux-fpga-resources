/dts-v1/;

/ {
    model = "Zynq Zedboard - FIR DMA Demo";
    compatible = "xlnx,zynq-7000";

    axi {
        #address-cells = <1>;
        #size-cells = <1>;

        fir@43c00000 {
            compatible = "acme,fir-dma-v1";
            reg = <0x43c00000 0x1000>;
            dmas = <&axi_dma 0>, <&axi_dma 1>;
            dma-names = "tx", "rx";
            status = "okay";
        };

        axi_dma: dma@40400000 {
            compatible = "xlnx,axi-dma-1.00.a";
            reg = <0x40400000 0x10000>;
            interrupts = <0 35 4>; // GIC SPI 35 level-high for S2MM
            status = "okay";
        };
    };
};

