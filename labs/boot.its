## labs/boot.its
```
/dts-v1/;

/ {
    description = "Custom Pynq-Z1 Boot Image";
    #address-cells = <1>;

    images {
        kernel {
            description = "Linux Kernel";
            data = /incbin/("zImage");
            type = "kernel";
            arch = "arm";
            os = "linux";
            compression = "none";
            load = <0x00080000>;
            entry = <0x00080000>;
            hash {
                algo = "sha1";
            };
        };

        fdt {
            description = "Device Tree Blob";
            data = /incbin/("pynq-z1.dtb");
            type = "flat_dt";
            arch = "arm";
            compression = "none";
            hash {
                algo = "sha1";
            };
        };
    };

    configurations {
        default = "config";
        config {
            description = "Boot Linux kernel with FDT";
            kernel = "kernel";
            fdt = "fdt";
        };
    };
};
```
